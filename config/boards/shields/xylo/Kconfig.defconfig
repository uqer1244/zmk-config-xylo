## config/boards/shields/xylo/Kconfig.defconfig
```kconfig
if SHIELD_XYLO_LEFT

    config ZMK_KEYBOARD_NAME
        default "xylo"

    config ZMK_SPLIT_BLE_ROLE_CENTRAL
        default y

endif # LEFT



if SHIELD_XYLO_LEFT || SHIELD_XYLO_RIGHT

    config ZMK_SPLIT
        default y

endif # LEFT RIGHT
```

## config/boards/shields/xylo/Kconfig.shield
```kconfig
config SHIELD_XYLO_LEFT
    def_bool $(shields_list_contains,xylo_left)

config SHIELD_XYLO_RIGHT
    def_bool $(shields_list_contains,xylo_right)
```
